## Kconfig
```kconfig
config SPANFSV3_FS
	tristate "The spanfsv3 filesystem"
	select JBD2
	select CRC16
	select CRYPTO
	select CRYPTO_CRC32C

config SPANFSV3_USE_FOR_EXT23
	bool "Use spanfsv3 for ext2/ext3 file systems"
	depends on SPANFSV3_FS
	depends on EXT3_FS=n || EXT2_FS=n
	default y

config SPANFSV3_FS_POSIX_ACL
	bool "Spanfsv3 POSIX Access Control Lists"
	depends on SPANFSV3_FS
	select FS_POSIX_ACL
config SPANFSV3_FS_SECURITY
	bool "Spanfsv3 Security Labels"
	depends on SPANFSV3_FS
config SPANFSV3_DEBUG
	bool "Spanfsv3 debugging support"
	depends on SPANFSV3_FS
```
